/*
 * Linker layout for the opt-in Lemu large-code-model build.
 *
 * This file is derived from the GNU ld x86-64 default linker script.  The
 * generated model is kept in the thin *__ALL.a archive and is placed in a
 * high-address island; CRT, runtime, GOT, and constructor sections remain in
 * the normal low-address island.
 */
/* Script for -z combreloc -z separate-code */
/* Copyright (C) 2014-2025 Free Software Foundation, Inc.
   Copying and distribution of this script, with or without modification,
   are permitted in any medium without royalty provided the copyright
   notice and this notice are preserved.  */
OUTPUT_FORMAT("elf64-x86-64", "elf64-x86-64", "elf64-x86-64")
OUTPUT_ARCH(i386:x86-64)
ENTRY(_start)
SECTIONS
{
  PROVIDE (__executable_start = SEGMENT_START("text-segment", 0x400000));
  . = SEGMENT_START("text-segment", 0x400000) + SIZEOF_HEADERS;
  /* Place the build-id as close to the ELF headers as possible.  This
     maximises the chance the build-id will be present in core files,
     which GDB can then use to locate the associated debuginfo file.  */
  .note.gnu.build-id  : { *(.note.gnu.build-id) }
  .interp         : { *(.interp) }
  .hash           : { *(.hash) }
  .gnu.hash       : { *(.gnu.hash) }
  .dynsym         : { *(.dynsym) }
  .dynstr         : { *(.dynstr) }
  .gnu.version    : { *(.gnu.version) }
  .gnu.version_d  : { *(.gnu.version_d) }
  .gnu.version_r  : { *(.gnu.version_r) }
  .rela.dyn       :
    {
      *(.rela.init)
      *(.rela.text .rela.text.* .rela.gnu.linkonce.t.*)
      *(.rela.fini)
      *(.rela.rodata .rela.rodata.* .rela.gnu.linkonce.r.*)
      *(.rela.eh_frame .rela.eh_frame.*)
      *(.rela.gcc_except_table .rela.gcc_except_table.*)
      *(.rela.sframe .rela.sframe.*)
      *(.rela.gnu_extab .rela.gnu_extab.*)
      *(.rela.exception_ranges .rela.exception_ranges.*)
      *(.rela.data .rela.data.* .rela.gnu.linkonce.d.*)
      *(.rela.tdata .rela.tdata.* .rela.gnu.linkonce.td.*)
      *(.rela.tbss .rela.tbss.* .rela.gnu.linkonce.tb.*)
      *(.rela.ctors)
      *(.rela.dtors)
      *(.rela.got)
      *(.rela.bss .rela.bss.* .rela.gnu.linkonce.b.*)
      *(.rela.ldata .rela.ldata.* .rela.gnu.linkonce.l.*)
      *(.rela.lbss .rela.lbss.* .rela.gnu.linkonce.lb.*)
      *(.rela.lrodata .rela.lrodata.* .rela.gnu.linkonce.lr.*)
      *(.rela.ifunc)
    }
  .rela.plt       :
    {
      *(.rela.plt)
      PROVIDE_HIDDEN (__rela_iplt_start = .);
      *(.rela.iplt)
      PROVIDE_HIDDEN (__rela_iplt_end = .);
    }
  .relr.dyn : { *(.relr.dyn) }
  /* Align the text segment.  */
  . = ALIGN(CONSTANT (MAXPAGESIZE));
  /* Start of the executable code region.  */
  .init           :
  {
    KEEP (*(SORT_NONE(.init)))
  }
  .plt            : { *(.plt) *(.iplt) }
.plt.got        : { *(.plt.got) }
.plt.sec        : { *(.plt.sec) }
  .text           :
  {
    EXCLUDE_FILE (*__ALL.a:*) *(.text.unlikely .text.*_unlikely .text.unlikely.*)
    EXCLUDE_FILE (*__ALL.a:*) *(.text.exit .text.exit.*)
    EXCLUDE_FILE (*__ALL.a:*) *(.text.startup .text.startup.*)
    EXCLUDE_FILE (*__ALL.a:*) *(.text.hot .text.hot.*)
    EXCLUDE_FILE (*__ALL.a:*) *(.text.sorted.*)
    EXCLUDE_FILE (*__ALL.a:*) *(.text .stub .text.* .gnu.linkonce.t.*)
    /* .gnu.warning sections are handled specially by elf.em.  */
    *(.gnu.warning)
  }
  .fini           :
  {
    KEEP (*(SORT_NONE(.fini)))
  }
  PROVIDE (__etext = .);
  PROVIDE (_etext = .);
  PROVIDE (etext = .);
  /* Align the text segment.  */
  . = ALIGN(CONSTANT (MAXPAGESIZE));
  /* Start of the Read Only Data region.  */
  /* Adjust the address for the rodata segment.  We want to adjust up to
     the same address within the page on the next page up.  */
  . = SEGMENT_START("rodata-segment", ALIGN(CONSTANT (MAXPAGESIZE)) + (. & (CONSTANT (MAXPAGESIZE) - 1)));
  .rodata         : { EXCLUDE_FILE (*__ALL.a:*) *(.rodata .rodata.* .gnu.linkonce.r.*) }
  .rodata1        : { *(EXCLUDE_FILE (*__ALL.a:*) .rodata1) }
  .eh_frame_hdr   : { *(.eh_frame_hdr) EXCLUDE_FILE (*__ALL.a:*) *(.eh_frame_entry .eh_frame_entry.*) }
  .eh_frame       : ONLY_IF_RO
  {
    KEEP (*(EXCLUDE_FILE (*__ALL.a:*) .eh_frame))
    *(EXCLUDE_FILE (*__ALL.a:*) .eh_frame.*)
  }
  .sframe         : ONLY_IF_RO { EXCLUDE_FILE (*__ALL.a:*) *(.sframe .sframe.*) }
  .gcc_except_table   : ONLY_IF_RO { EXCLUDE_FILE (*__ALL.a:*) *(.gcc_except_table .gcc_except_table.*) }
  .gnu_extab   : ONLY_IF_RO { *(EXCLUDE_FILE (*__ALL.a:*) .gnu_extab*) }
  /* These sections are generated by the Sun/Oracle C++ compiler.  */
  .exception_ranges   : ONLY_IF_RO { *(EXCLUDE_FILE (*__ALL.a:*) .exception_ranges*) }
  /* Various note sections.  Placed here so that they are always included
     in the read-only segment and not treated as orphan sections.  The
     current orphan handling algorithm does place note sections after R/O
     data, but this is not guaranteed to always be the case.  */
  .note.build-id :      { *(.note.build-id) }
  .note.GNU-stack :     { *(.note.GNU-stack) }
  .note.gnu-property :  { *(.note.gnu-property) }
  .note.ABI-tag :       { *(.note.ABI-tag) }
  .note.package :       { *(.note.package) }
  .note.dlopen :        { *(.note.dlopen) }
  .note.netbsd.ident :  { *(.note.netbsd.ident) }
  .note.openbsd.ident : { *(.note.openbsd.ident) }
  /* Start of the Read Write Data region.  */
  /* Adjust the address for the data segment.  We want to adjust up to
     the same address within the page on the next page up.  */
  . = DATA_SEGMENT_ALIGN (CONSTANT (MAXPAGESIZE), CONSTANT (COMMONPAGESIZE));
  /* Exception handling.  */
  .eh_frame       : ONLY_IF_RW
  {
    KEEP (*(EXCLUDE_FILE (*__ALL.a:*) .eh_frame))
    *(EXCLUDE_FILE (*__ALL.a:*) .eh_frame.*)
  }
  .sframe         : ONLY_IF_RW { EXCLUDE_FILE (*__ALL.a:*) *(.sframe .sframe.*) }
  .gnu_extab      : ONLY_IF_RW { *(EXCLUDE_FILE (*__ALL.a:*) .gnu_extab) }
  .gcc_except_table   : ONLY_IF_RW { EXCLUDE_FILE (*__ALL.a:*) *(.gcc_except_table .gcc_except_table.*) }
  .exception_ranges   : ONLY_IF_RW { *(EXCLUDE_FILE (*__ALL.a:*) .exception_ranges*) }
  /* Thread Local Storage sections.  */
  .tdata	  :
   {
     PROVIDE_HIDDEN (__tdata_start = .);
     EXCLUDE_FILE (*__ALL.a:*) *(.tdata .tdata.* .gnu.linkonce.td.*)
   }
  .tbss		  :
  {
    EXCLUDE_FILE (*__ALL.a:*) *(.tbss .tbss.* .gnu.linkonce.tb.*)
    *(EXCLUDE_FILE (*__ALL.a:*) .tcommon)
  }
  .preinit_array    :
  {
    PROVIDE_HIDDEN (__preinit_array_start = .);
    KEEP (*(.preinit_array))
    PROVIDE_HIDDEN (__preinit_array_end = .);
  }
  .init_array    :
  {
    PROVIDE_HIDDEN (__init_array_start = .);
    KEEP (*(SORT_BY_INIT_PRIORITY(.init_array.*) SORT_BY_INIT_PRIORITY(.ctors.*)))
    KEEP (*(.init_array EXCLUDE_FILE (*crtbegin.o *crtbegin?.o *crtend.o *crtend?.o ) .ctors))
    PROVIDE_HIDDEN (__init_array_end = .);
  }
  .fini_array    :
  {
    PROVIDE_HIDDEN (__fini_array_start = .);
    KEEP (*(SORT_BY_INIT_PRIORITY(.fini_array.*) SORT_BY_INIT_PRIORITY(.dtors.*)))
    KEEP (*(.fini_array EXCLUDE_FILE (*crtbegin.o *crtbegin?.o *crtend.o *crtend?.o ) .dtors))
    PROVIDE_HIDDEN (__fini_array_end = .);
  }
  .ctors          :
  {
    /* gcc uses crtbegin.o to find the start of
       the constructors, so we make sure it is
       first.  Because this is a wildcard, it
       doesn't matter if the user does not
       actually link against crtbegin.o; the
       linker won't look for a file to match a
       wildcard.  The wildcard also means that it
       doesn't matter which directory crtbegin.o
       is in.  */
    KEEP (*crtbegin.o(.ctors))
    KEEP (*crtbegin?.o(.ctors))
    /* We don't want to include the .ctor section from
       the crtend.o file until after the sorted ctors.
       The .ctor section from the crtend file contains the
       end of ctors marker and it must be last */
    KEEP (*(EXCLUDE_FILE (*crtend.o *crtend?.o ) .ctors))
    KEEP (*(SORT(.ctors.*)))
    KEEP (*(.ctors))
  }
  .dtors          :
  {
    KEEP (*crtbegin.o(.dtors))
    KEEP (*crtbegin?.o(.dtors))
    KEEP (*(EXCLUDE_FILE (*crtend.o *crtend?.o ) .dtors))
    KEEP (*(SORT(.dtors.*)))
    KEEP (*(.dtors))
  }
  .jcr            : { KEEP (*(.jcr)) }
  .data.rel.ro :
  {
    EXCLUDE_FILE (*__ALL.a:*) *(.data.rel.ro.local* .gnu.linkonce.d.rel.ro.local.*)
    EXCLUDE_FILE (*__ALL.a:*) *(.data.rel.ro .data.rel.ro.* .gnu.linkonce.d.rel.ro.*)
  }
  .dynamic        : { *(.dynamic) }
  .got            : { *(.got) *(.igot) }
  . = DATA_SEGMENT_RELRO_END (SIZEOF (.got.plt) >= 24 ? 24 : 0, .);
  .got.plt        : { *(.got.plt) *(.igot.plt) }
  .data           :
  {
    EXCLUDE_FILE (*__ALL.a:*) *(.data .data.* .gnu.linkonce.d.*)
    SORT(CONSTRUCTORS)
  }
  /* crtbegin/crtend emit this zero-sized table; keep it in the low island
     rather than relying on orphan-section placement near .data/.bss. */
  .tm_clone_table : { *(.tm_clone_table) }
  .data1          : { *(EXCLUDE_FILE (*__ALL.a:*) .data1) }
  _edata = .;
  PROVIDE (edata = .);
  . = ALIGN(ALIGNOF(NEXT_SECTION));
  __bss_start = .;
  .bss            :
  {
    *(.dynbss)
    EXCLUDE_FILE (*__ALL.a:*) *(.bss .bss.* .gnu.linkonce.b.*)
    *(EXCLUDE_FILE (*__ALL.a:*) COMMON)
    /* Align here to ensure that in the common case of there only being one
       type of .bss section, the section occupies space up to _end.
       Align after .bss to ensure correct alignment even if the
       .bss section disappears because there are no input sections.
       FIXME: Why do we need it? When there is no .bss section, we do not
       pad the .data section.  */
      . = ALIGN(. != 0 ? 64 / 8 : 1);
  }
    .lbss   :
    {
      *(.dynlbss)
      EXCLUDE_FILE (*__ALL.a:*) *(.lbss .lbss.* .gnu.linkonce.lb.*)
      *(EXCLUDE_FILE (*__ALL.a:*) LARGE_COMMON)
    }
    . = ALIGN(64 / 8);
  /* Start of the Large Data region.  */
  . = SEGMENT_START("ldata-segment", .);
  .lrodata   ALIGN(CONSTANT (MAXPAGESIZE)) + (. & (CONSTANT (MAXPAGESIZE) - 1)) :
  {
    EXCLUDE_FILE (*__ALL.a:*) *(.lrodata .lrodata.* .gnu.linkonce.lr.*)
  }
  .ldata   ALIGN(CONSTANT (MAXPAGESIZE)) + (. & (CONSTANT (MAXPAGESIZE) - 1)) :
  {
    EXCLUDE_FILE (*__ALL.a:*) *(.ldata .ldata.* .gnu.linkonce.l.*)
      . = ALIGN(. != 0 ? 64 / 8 : 1);
  }
  . = ALIGN(64 / 8);
  . = DATA_SEGMENT_END (.);

  /*
     Verilated model objects are compiled with -mcmodel=large and live after
     the complete low-address CRT/runtime island.  Constructor arrays remain
     in the normal low-address output sections above; their entries contain
     absolute function pointers and may therefore point into .model_text.
  */
  . = ALIGN(CONSTANT (MAXPAGESIZE));
  .model_text :
  {
    /* Keep each archive member's .text and partitioned cold/hot sections
       adjacent.  Grouping all .text.unlikely sections before all .text
       sections can overflow the compiler-emitted PC-relative edges between
       those sections even when the object uses -mcmodel=large. */
    *__ALL.a:*(.text .text.* .stub .gnu.linkonce.t.*)
  }

  . = ALIGN(CONSTANT (MAXPAGESIZE));
  .model_rodata :
  {
    *__ALL.a:*(.rodata .rodata.* .rodata1 .lrodata .lrodata.*
                      .gnu.linkonce.r.* .gnu.linkonce.lr.*)
  }

  . = ALIGN(CONSTANT (MAXPAGESIZE));
  .model_data :
  {
    *__ALL.a:*(.data.rel.ro.local* .gnu.linkonce.d.rel.ro.local.*)
    *__ALL.a:*(.data.rel.ro .data.rel.ro.* .gnu.linkonce.d.rel.ro.*)
    *__ALL.a:*(.data .data.* .data1 .ldata .ldata.*
                      .gnu.linkonce.d.* .gnu.linkonce.l.*)
  }

  . = ALIGN(CONSTANT (MAXPAGESIZE));
  .model_bss (NOLOAD) :
  {
    *__ALL.a:*(.bss .bss.* .lbss .lbss.*
                      .gnu.linkonce.b.* .gnu.linkonce.lb.*)
    *__ALL.a:*(COMMON LARGE_COMMON)
    . = ALIGN(. != 0 ? 64 / 8 : 1);
  }

  /* Verilator's generated model should not define TLS.  Splitting one PT_TLS
     across the low and model islands would create an unusably large TLS block,
     so reject it explicitly instead of silently producing a bad executable. */
  .model_tdata :
  {
    *__ALL.a:*(.tdata .tdata.* .gnu.linkonce.td.*)
  }
  .model_tbss (NOLOAD) :
  {
    *__ALL.a:*(.tbss .tbss.* .gnu.linkonce.tb.* .tcommon)
  }
  ASSERT(SIZEOF(.model_tdata) == 0,
         "model archive unexpectedly contains initialized TLS")
  ASSERT(SIZEOF(.model_tbss) == 0,
         "model archive unexpectedly contains zero-initialized TLS")

  . = ALIGN(64 / 8);
  _end = .;
  PROVIDE (end = .);
  /* Start of the Tiny Data region.  */
  /* Stabs debugging sections.  */
  .stab          0 : { *(.stab) }
  .stabstr       0 : { *(.stabstr) }
  .stab.excl     0 : { *(.stab.excl) }
  .stab.exclstr  0 : { *(.stab.exclstr) }
  .stab.index    0 : { *(.stab.index) }
  .stab.indexstr 0 : { *(.stab.indexstr) }
  .comment 0 (INFO) : { *(.comment); LINKER_VERSION; }
  .gnu.build.attributes : { *(.gnu.build.attributes .gnu.build.attributes.*) }
  /* DWARF debug sections.
     Symbols in the DWARF debugging sections are relative to the beginning
     of the section so we begin them at 0.  */
  /* DWARF 1.  */
  .debug          0 : { *(.debug) }
  .line           0 : { *(.line) }
  /* GNU DWARF 1 extensions.  */
  .debug_srcinfo  0 : { *(.debug_srcinfo) }
  .debug_sfnames  0 : { *(.debug_sfnames) }
  /* DWARF 1.1 and DWARF 2.  */
  .debug_aranges  0 : { *(.debug_aranges) }
  .debug_pubnames 0 : { *(.debug_pubnames) }
  /* DWARF 2.  */
  .debug_info     0 : { *(.debug_info .gnu.linkonce.wi.*) }
  .debug_abbrev   0 : { *(.debug_abbrev) }
  .debug_line     0 : { *(.debug_line .debug_line.* .debug_line_end) }
  .debug_frame    0 : { *(.debug_frame) }
  .debug_str      0 : { *(.debug_str) }
  .debug_loc      0 : { *(.debug_loc) }
  .debug_macinfo  0 : { *(.debug_macinfo) }
  /* SGI/MIPS DWARF 2 extensions.  */
  .debug_weaknames 0 : { *(.debug_weaknames) }
  .debug_funcnames 0 : { *(.debug_funcnames) }
  .debug_typenames 0 : { *(.debug_typenames) }
  .debug_varnames  0 : { *(.debug_varnames) }
  /* DWARF 3.  */
  .debug_pubtypes 0 : { *(.debug_pubtypes) }
  .debug_ranges   0 : { *(.debug_ranges) }
  /* DWARF 5.  */
  .debug_addr     0 : { *(.debug_addr) }
  .debug_line_str 0 : { *(.debug_line_str) }
  .debug_loclists 0 : { *(.debug_loclists) }
  .debug_macro    0 : { *(.debug_macro) }
  .debug_names    0 : { *(.debug_names) }
  .debug_rnglists 0 : { *(.debug_rnglists) }
  .debug_str_offsets 0 : { *(.debug_str_offsets) }
  .debug_sup      0 : { *(.debug_sup) }
  .gnu.attributes 0 : { KEEP (*(.gnu.attributes)) }
  /DISCARD/ :
  {
    *__ALL.a:*(.eh_frame .eh_frame.* .sframe .sframe.*
                      .gcc_except_table .gcc_except_table.*
                      .gnu_extab* .exception_ranges*)
    *(.note.GNU-stack) *(.gnu_debuglink) *(.gnu.lto_*) *(.gnu_object_only)
  }
}
